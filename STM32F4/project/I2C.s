RCC_BASE					EQU 0x40023800
GPIOA_BASE					EQU 0x40020000
GPIOB_BASE					EQU 0x40020400
GPIOC_BASE					EQU 0x40020800
I2C1_BASE					EQU 0x40005400



RCC_AHB1_ENR_OFFSET			EQU 0x30
RCC_APB1_ENR_OFFSET			EQU 0x40
	
GPIO_AFRH_LR_OFFSET			EQU 0x20			;0-7
GPIO_AFRH_HR_OFFSET			EQU 0x24			;8-15
GPIO_MODER_OFFSET			EQU 0x00
GPIO_OTYPER_OFFSET			EQU 0x04
GPIOB_OSPEEDER_OFFSET		EQU 0x08
GPIO_BSRR_OFFSET			EQU 0x18
GPIO_IDR_OFFSET				EQU 0x10

I2C_CR1_OFFSET				EQU 0x00
I2C_CR2_OFFSET				EQU 0x04
I2C_OAR1_OFFSET				EQU 0x08
I2C_DR_OFFSET				EQU 0x10
I2C_SR1_OFFSET				EQU 0x14
I2C_SR2_OFFSET				EQU 0x18
I2C_CCR_OFFSET				EQU 0x1C
I2C_TRISE_OFFSET			EQU 0x20

		
RCC_AHB1_GPIOB_CLOCK_BIT	EQU 1
RCC_APB1_I2C1_CLOCK_BIT		EQU 21

;I2C_CR1
I2C_START					EQU 0x08
I2C_STOP					EQU 0x09
I2C_SMBTYPE					EQU 0x03
I2C_PE						EQU 0x00
;I2C_CR2
I2C_FREQ					EQU 0x00
I2C_CCR						EQU 0x00
;I2C_CCR_GG					EQU 0x7D			;25M
I2C_CCR_GG					EQU 0x50			;16M
;I2C_SR1
I2C_SR1_TxE					EQU 7
I2C_SR1_SB					EQU 0
I2C_SR1_SMBALERT			EQU 15
I2C_SR1_ADDR				EQU 1
	

	AREA	FUNCTION,CODE,READONLY, ALIGN=8
	EXPORT I2C_INIT
	EXPORT I2C_WRITE
	
		
I2C_INIT	PROC
	PUSH {R0-R1}
	
	LDR R0, =RCC_BASE
	LDR R1, [R0, #RCC_AHB1_ENR_OFFSET]
	ORR R1, R1, #(1 << RCC_AHB1_GPIOB_CLOCK_BIT)
	STR R1, [R0, #RCC_AHB1_ENR_OFFSET]
		
	LDR R1, [R0, #RCC_APB1_ENR_OFFSET]
	ORR R1, R1, #(1 << RCC_APB1_I2C1_CLOCK_BIT)
	STR R1, [R0, #RCC_APB1_ENR_OFFSET]
	
	
	LDR R0, =GPIOB_BASE
	LDR R1, [R0, #GPIO_AFRH_HR_OFFSET]
	ORR R1, #(4 << (0 * 4))						;AF4 PB8
	ORR R1, #(4 << (1 * 4))						;AF4 PB9
	STR R1, [R0, #GPIO_AFRH_HR_OFFSET]

	
	LDR R1, [R0, #GPIO_MODER_OFFSET]
	BIC R1, #(1 << (8 * 2))
	ORR R1, #(1 << (8 * 2 + 1))
	BIC R1, #(1 << (9 * 2))
	ORR R1, #(1 << (9 * 2 + 1))
	STR R1, [R0, #GPIO_MODER_OFFSET]
	
	
	LDR R1, [R0, #GPIO_OTYPER_OFFSET]
	ORR R1, #(1 << 8)
	ORR R1, #(1 << 9)
	STR R1, [R0, #GPIO_OTYPER_OFFSET]
	
	
	LDR R1, [R0, #GPIOB_OSPEEDER_OFFSET]
	ORR R1, #(2 << 8 * 2)
	ORR R1, #(2 << 9 * 2)
	STR R1, [R0, #GPIOB_OSPEEDER_OFFSET]
	

	LDR R0, =I2C1_BASE
	LDR R1, [R0, #I2C_CR2_OFFSET]
	ORR R1, #16
	STR R1, [R0, #I2C_CR2_OFFSET]
	
	LDR R1, [R0, #I2C_TRISE_OFFSET]
	ORR R1, #17
	STR R1, [R0, #I2C_TRISE_OFFSET]
	
	LDR R1, [R0, #I2C_CCR_OFFSET]
	MOV R1, #I2C_CCR_GG	
	STR R1, [R0, #I2C_CCR_OFFSET]

	LDR R1, [R0, #I2C_CR1_OFFSET]
	ORR R1, #(1 << I2C_PE)
	STR R1, [R0, #I2C_CR1_OFFSET]
	
	POP {R0-R1}
	BX LR
	ENDP
		
		
		
I2C_WRITE	PROC	
	PUSH {R4-R6}
	
	LDR R4, =I2C1_BASE
	LDR R6, [R4, #I2C_CR1_OFFSET]
	ORR R6, #(1 << I2C_START)
	STR R6, [R4, #I2C_CR1_OFFSET]
	
WAIT_SB
	LDR R6, [R4, #I2C_SR1_OFFSET]
	AND R6, #(1 << I2C_SR1_SB)
	CMP R6, #(1 << I2C_SR1_SB)
	BNE WAIT_SB
	
	LDR R6, [R4, #I2C_SR1_OFFSET]
	LDR R6, [R4, #I2C_SR2_OFFSET]
	
	;address
	;LDR R3, [R4, #I2C_DR_OFFSET]
	;MOV R3, #ADDRESS_SLAVE
	STR R0, [R4, #I2C_DR_OFFSET]
WAIT_ADDR
	LDR R6, [R4, #I2C_SR1_OFFSET]
	AND R6, #(1 << I2C_SR1_ADDR)
	CMP R6, #(1 << I2C_SR1_ADDR)
	BNE WAIT_ADDR	
	
	;necessarily
	LDR R6, [R4, #I2C_SR1_OFFSET]
	LDR R6, [R4, #I2C_SR2_OFFSET]
	
	;write
	;LDR R3, [R4, #I2C_DR_OFFSET]
WAIT_TxE
	LDR R6, [R4, #I2C_SR1_OFFSET]
	AND R6, #(1 << I2C_SR1_TxE)
	CMP R6, #(1 << I2C_SR1_TxE)
	BNE WAIT_TxE
	
	LDR R5, [R1], #1
 	STR R5, [R4, #I2C_DR_OFFSET]
	
	SUBS R2, #1
	BNE WAIT_TxE
	
END_WAIT_TxE
	LDR R6, [R4, #I2C_SR1_OFFSET]
	AND R6, #(1 << I2C_SR1_TxE)
	CMP R6, #(1 << I2C_SR1_TxE)
	BNE END_WAIT_TxE
	
	
	;stop
STOP_
	LDR R6, [R4, #I2C_CR1_OFFSET]
	ORR R6, R6, #(1 << I2C_STOP)
	STR R6, [R4, #I2C_CR1_OFFSET]
	

	POP {R4-R6}
	BX LR
	ENDP
		
	ALIGN
		
	END